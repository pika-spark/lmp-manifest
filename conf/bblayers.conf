## conf/bblayers.conf
```bitbake
# LAYER_CONF_VERSION is increased each time build/conf/bblayers.conf
# changes incompatibly
LCONF_VERSION = "7"
OEROOT := "${@os.path.abspath(os.path.dirname(d.getVar('FILE', True)))}/../.."

BBPATH = "${TOPDIR}"

BBFILES = ""

require bblayers-base.inc
require bblayers-bsp.inc

include bblayers-partner.inc
include bblayers-factory.inc

BBLAYERS = " \
  ${OEROOT}/layers/meta-lmp/meta-lmp-base \
  ${BASELAYERS} \
  ${BSPLAYERS} \
  ${OEROOT}/layers/openembedded-core/meta \
  ${OEROOT}/layers/meta-openembedded/meta-multimedia \
  ${OEROOT}/layers/meta-ros/meta-ros-common \
  ${OEROOT}/layers/meta-ros/meta-ros2 \
  ${OEROOT}/layers/meta-ros/meta-ros2-jazzy \
  ${OEROOT}/layers/meta-hailo/meta-hailo-accelerator \
  ${OEROOT}/layers/meta-hailo/meta-hailo-libhailort \
"
```
